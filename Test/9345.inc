;	EF9345 DRIVER FOR ROMWBW
;
;	PARTS WRITTEN BY: ALAN COX
;	REVISED/ENHANCED BY DAN WERNER -- 11/7/2009
;======================================================================
; TODO:
;   - VDAFIL : VALIDATE COUNT OF CHARACTERS
;   - CHECK SCROLL UP/DOWN
;	- 40X24 IMPLEMENTATION
;
#INCLUDE "../../HBIOS/hbios.inc"

FALSE		.EQU	0
TRUE		.EQU	~FALSE
BDOS		.EQU	5
HBIOS		.EQU	$FFF0
;
#DEFINE	PRTC(C)	CALL PRTCH \ .DB C	; PRINT CHARACTER C TO CONSOLE - PRTC('X')
#DEFINE	PRTS(S)	CALL PRTSTRD \ .TEXT S	; PRINT STRING S TO CONSOLE - PRTD("HELLO")
#DEFINE	PRTX(X) CALL PRTSTRI \ .DW X	; PRINT STRING AT ADDRESS X TO CONSOLE - PRTI(STR_HELLO)
;
#DEFINE USEDELAY
#DEFINE DEBUG
VDA_FNCNT .EQU	16
;
;======================================================================
; EF9345 DRIVER - CONSTANTS
;======================================================================
;
VDADEV_EF9345	.EQU	$60		; EF9345 CARD
V80X24			.EQU	10		; EF9345 80x24
V40X24			.EQU	11		; EF9345 80x24
;
EF9345SIZE		.SET	V80X24         ; V80X24 | V40X24
;
EF9345_BASE	.EQU	$40
SETREG		.EQU	EF9345_BASE + 4
DATAACC		.EQU	EF9345_BASE + 5
EFRESET     .EQU    EF9345_BASE + 6
;
R0		.EQU	$20
R1		.EQU	R0+1
R2		.EQU	R0+2
R3		.EQU	R0+3
R4		.EQU	R0+4
R5		.EQU	R0+5
R6		.EQU	R0+6
R7		.EQU	R0+7
;
XA		.EQU	R5
YA		.EQU	R4
XP		.EQU	R7
YP		.EQU	R6
;
EXEC	.EQU	00001000b
;BUSY	.EQU	10000000b
;
TGSREG	 	.EQU 	1
MATREG		.EQU	2
PATREG		.EQU	3
DORREG		.EQU	4
RORREG		.EQU	7
;WRTINDIR	.EQU 10000000b
;
; CMD
;
NOP		.EQU	$91		;
IND		.EQU	$80		;
CLF		.EQU	$05		;
OCT		.EQU	$30		;
OCTAUX	.EQU	$04		; AUXILIARY POITER
KRF		.EQU	$00		; no autoincrement
KRL		.EQU	$50		; no autoincrement.
INY		.EQU	$B0		; INC Y
;
IND_TGS		.EQU	$81
IND_MAT		.EQU	$82
IND_PAT		.EQU	$83
IND_DOR		.EQU	$84
IND_ROR		.EQU	$87
RDREG	.EQU	00001000b
WRREG	.EQU    ~RDREG
;
; | 1 | 0 | 0| 0| R/!W | r | r | r |   IND command
;                        0   0   1     TGS
;                        0   1   0     MAT
;                        0   1   1     PAT
;                        1   0   0     DOR
;                        1   0   1
;                        1   1   0
;                        1   1   1     ROR
;
FALSE		.EQU	0
TRUE		.EQU	~FALSE
BDOS		.EQU	5
;						MAT5	MAT4
; fixed complemented	  0		  0
; flash complemented	  1		  0
; fixed underlined		  0		  1
; flash underlined		  1		  1
;
EF9345_NOCU	.EQU	10111111B	; MAT6 = 0 : NO CURSOR
EF9345_BLK	.EQU	00100000B	; MAT5 = 1 : BLINK CURSOR
EF9345_NOBL	.EQU	11011111B	; MAT5 = 0 : NO BLINK
;
EF9345_BLOK	.EQU	11101111b	; MAT4 = 0 : BLOCK CURSOR
EF9345_ULIN	.EQU	00010000b	; MAT4 = 1 : UNDERLINE CURSOR
;
;EF9345_CSTY	.EQU	EF9345_BLOK	; DEFAULT CURSOR STYLE
;EF9345_BLNK	.EQU	EF9345_NOBL	; DEFAULT BLINK RATE
;
;
EF9345_CURENA	.EQU	TRUE			; ENABLE CURSOR
;EF9345_CURREV	.EQU	TRUE			; REVERSE BLOCK CURSOR
;EF9345_CURBLI	.EQU	FALSE			; BLINKING CURSOR
;EF9345_CURUDL	.EQU	~EF9345_CURREV	; UNDERLINED CURSOR
;
EF9345_MARCOL	.EQU	00000000B		; MARGIN COLOR BLACK : MAT0 = R, MAT1 = G, MAT2 = B
EF9345_MARENA	.EQU	00001000B		; MARGIN INSERT : MAT3 = 1
;
EF9345_CUREN	.EQU	01000000B	; MAT6 = 1 : CURSOR ENABLED
EF9345_DISCU	.EQU	10111111B	; MAT6 = 0 : NO CURSOR
;
EF9345_FLASH	.EQU	00100000B	; MAT5 = 1 : BLINK CURSOR
EF9345_NOFLASH	.EQU	11011111B	; MAT5 = 0 : NO BLINK
;
EF9345_COMPL	.EQU	11101111b	; MAT4 = 0 : BLOCK CURSOR
EF9345_ULIN		.EQU	00010000b	; MAT4 = 1 : UNDERLINE CURSOR
;
EF9345_FLASHCHAR    .EQU    00001000B
EF9345_REVERSCHAR   .EQU    10000000B
;
#IF EF9345_CURENA
EF9345_CSTY .SET EF9345_CUREN | EF9345_FLASH | EF9345_ULIN | EF9345_MARENA | EF9345_MARCOL
#ELSE
EF9345_CSTY .SET EF9345_MARENA | EF9345_MARCOL
#ENDIF
;
FIRSTLINE	.EQU	8
;
#IF (EF9345SIZE=V80X24)
DLINES		.EQU	24
DROWS		.EQU	80
DSCANL		.EQU	10
; ATTRIBUTES
EF_FLASH		.EQU	01000100B
EF_NEGATIVE		.EQU	10001000B
EF_UNDERLINE	.EQU	00100010B
EF_COLORSET		.EQU	00010001B
#ENDIF
;
#IF (EF9345SIZE=V40X24)
DLINES		.EQU	24
DROWS		.EQU	40
DSCANL		.EQU	10
; ATTRIBUTES
EF_FLASH		.EQU	01000100B
EF_NEGATIVE		.EQU	10001000B
EF_UNDERLINE	.EQU	00100010B
EF_COLORSET		.EQU	00010001B
#ENDIF
;
; DISTRICTS
;
DIST0 	.EQU 	0
DIST1 	.EQU 	$20
DIST2 	.EQU 	$80
DIST3 	.EQU 	$A0
;
;
BG_BLACK	.EQU	$0
BG_RED		.EQU	$10
BG_GREEN	.EQU	$20
BG_BROWN	.EQU	$30
BG_BLUE		.EQU	$40
BG_MAGENTA	.EQU	$50
BG_CYAN		.EQU	$60
BG_WHITE	.EQU	$70
FG_BLACK	.EQU	0
FG_RED		.EQU	1
FG_GREEN	.EQU	2
FG_BROWN	.EQU	3
FG_BLUE		.EQU	4
FG_MAGENTA	.EQU	5
FG_CYAN		.EQU	6
FG_WHITE	.EQU	7
;
SCREENSIZE	.EQU	DROWS * DLINES
;
;EF_IDAT		.EQU	0			; NO INSTANCE DATA ASSOCIATED WITH THIS DEVICE
;
